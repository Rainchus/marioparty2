SECTIONS
{
    __romPos = 0x0;
    . = __romPos;
    header_ROM_START = __romPos;
    header_VRAM = ADDR(.header);
    .header : AT(header_ROM_START) SUBALIGN(16)
    {
        header_TEXT_END = .;
        header_DATA_START = .;
        header_s = .;
        build/asm/header.s.o(.data);
        header_DATA_END = .;
    }
    header_ROM_END = 0x40;
    __romPos = 0x40;

    __romPos = 0x40;
    . = __romPos;
    boot_ROM_START = __romPos;
    boot_VRAM = ADDR(.boot);
    .boot : AT(boot_ROM_START) SUBALIGN(16)
    {
        boot_TEXT_END = .;
        boot_DATA_START = .;
        boot_bin = .;
        build/assets/boot.bin.o(.data);
        boot_DATA_END = .;
    }
    boot_ROM_END = 0x1000;
    __romPos = 0x1000;

    __romPos = 0x1000;
    . = __romPos;
    main_ROM_START = __romPos;
    main_VRAM = ADDR(.main);
    .main 0x80000400 : AT(main_ROM_START) SUBALIGN(16)
    {
        main_TEXT_START = .;
        build/asm/1000.s.o(.text);
        build/src/B6E0.c.o(.text);
        build/src/C8E0.c.o(.text);
        build/src/ECC0.c.o(.text);
        build/src/ECE0.c.o(.text);
        build/src/169B0.c.o(.text);
        build/src/17EF0.c.o(.text);
        build/src/187C0.c.o(.text);
        build/src/19630.c.o(.text);
        build/src/19A30.c.o(.text);
        build/src/19BF0.c.o(.text);
        build/src/1AE60.c.o(.text);
        build/src/1B8D0.c.o(.text);
        build/src/1C7C0.c.o(.text);
        build/src/1D0B0.c.o(.text);
        build/src/20C70.c.o(.text);
        build/src/21920.c.o(.text);
        build/src/26370.c.o(.text);
        build/src/274D0.c.o(.text);
        build/src/2E0D0.c.o(.text);
        build/src/30560.c.o(.text);
        build/src/3D4E0.c.o(.text);
        build/src/3D6A0.c.o(.text);
        build/src/415E0.c.o(.text);
        build/src/426A0.c.o(.text);
        build/src/437E0.c.o(.text);
        build/src/43E90.c.o(.text);
        build/src/45400.c.o(.text);
        build/src/459D0.c.o(.text);
        build/src/46250.c.o(.text);
        build/src/4A500.c.o(.text);
        build/src/4ABB0.c.o(.text);
        build/src/4D660.c.o(.text);
        build/src/4F650.c.o(.text);
        build/src/50E70.c.o(.text);
        build/src/512A0.c.o(.text);
        build/src/51630.c.o(.text);
        build/src/54CB0.c.o(.text);
        build/src/565E0.c.o(.text);
        build/src/57150.c.o(.text);
        build/src/58080.c.o(.text);
        build/src/5EF10.c.o(.text);
        build/src/5F3B0.c.o(.text);
        build/src/63670.c.o(.text);
        build/src/67FA0.c.o(.text);
        build/src/68990.c.o(.text);
        build/src/69060.c.o(.text);
        build/src/69950.c.o(.text);
        build/src/733F0.c.o(.text);
        build/src/73BA0.c.o(.text);
        build/src/743F0.c.o(.text);
        build/src/74AA0.c.o(.text);
        build/src/76CC0.c.o(.text);
        build/src/7AA60.c.o(.text);
        build/src/7C9A0.c.o(.text);
        build/src/7CF70.c.o(.text);
        build/src/7D1D0.c.o(.text);
        build/src/7E850.c.o(.text);
        build/src/7FAE0.c.o(.text);
        build/src/80230.c.o(.text);
        build/src/84FF0.c.o(.text);
        build/src/8FBB0.c.o(.text);
        build/src/939A0.c.o(.text);
        build/src/93A80.c.o(.text);
        build/src/978F0.c.o(.text);
        build/src/97D60.c.o(.text);
        build/src/99370.c.o(.text);
        build/src/995C0.c.o(.text);
        build/src/99690.c.o(.text);
        build/src/997E0.c.o(.text);
        build/src/998D0.c.o(.text);
        build/src/99D50.c.o(.text);
        build/src/99FE0.c.o(.text);
        build/src/9A210.c.o(.text);
        build/src/9B990.c.o(.text);
        build/src/9BAF0.c.o(.text);
        build/src/9BBE0.c.o(.text);
        build/src/9BC80.c.o(.text);
        build/src/9BE10.c.o(.text);
        build/src/9BFD0.c.o(.text);
        build/src/9C070.c.o(.text);
        build/src/9C410.c.o(.text);
        build/src/9C540.c.o(.text);
        build/src/9CA50.c.o(.text);
        build/src/9D1C0.c.o(.text);
        build/src/9D320.c.o(.text);
        build/src/9D6D0.c.o(.text);
        build/src/9D750.c.o(.text);
        build/src/9D840.c.o(.text);
        build/src/9D8C0.c.o(.text);
        build/src/9E2C0.c.o(.text);
        build/src/9E740.c.o(.text);
        build/src/9E7A0.c.o(.text);
        build/src/9E800.c.o(.text);
        build/src/9E8A0.c.o(.text);
        build/src/9EA20.c.o(.text);
        build/src/9EDE0.c.o(.text);
        build/src/9EED0.c.o(.text);
        build/src/9F000.c.o(.text);
        build/src/9F0A0.c.o(.text);
        build/src/9F6C0.c.o(.text);
        build/src/9F770.c.o(.text);
        build/src/9F7B0.c.o(.text);
        build/src/9F800.c.o(.text);
        build/src/9F840.c.o(.text);
        build/src/A0340.c.o(.text);
        build/src/A0360.c.o(.text);
        build/src/A0380.c.o(.text);
        build/src/A0400.c.o(.text);
        build/src/A0430.c.o(.text);
        build/src/A0440.c.o(.text);
        build/src/A0470.c.o(.text);
        build/src/A0580.c.o(.text);
        build/src/A17E0.c.o(.text);
        build/src/A1810.c.o(.text);
        build/src/A18D0.c.o(.text);
        build/src/A1920.c.o(.text);
        build/src/A19E0.c.o(.text);
        build/src/A1A50.c.o(.text);
        build/src/A1A80.c.o(.text);
        build/src/A1AD0.c.o(.text);
        build/src/A1B20.c.o(.text);
        build/src/A1B70.c.o(.text);
        build/src/A21B0.c.o(.text);
        build/src/A21C0.c.o(.text);
        build/src/A22B0.c.o(.text);
        build/src/A2350.c.o(.text);
        build/src/A25B0.c.o(.text);
        build/src/A2650.c.o(.text);
        build/src/A27A0.c.o(.text);
        build/src/A28E0.c.o(.text);
        build/src/A2940.c.o(.text);
        build/src/A2A70.c.o(.text);
        build/src/A2AF0.c.o(.text);
        build/src/A2B20.c.o(.text);
        build/src/A2D00.c.o(.text);
        build/src/A3010.c.o(.text);
        build/src/A30D0.c.o(.text);
        build/src/A3930.c.o(.text);
        build/src/A4390.c.o(.text);
        build/src/A4980.c.o(.text);
        build/src/A4B10.c.o(.text);
        build/src/A5110.c.o(.text);
        build/src/A5490.c.o(.text);
        build/src/A54C0.c.o(.text);
        build/src/A57A0.c.o(.text);
        build/src/A5AC0.c.o(.text);
        build/src/A5BA0.c.o(.text);
        build/src/A5E10.c.o(.text);
        build/src/A6260.c.o(.text);
        build/src/A62F0.c.o(.text);
        build/src/A6320.c.o(.text);
        build/src/A6350.c.o(.text);
        build/src/A6490.c.o(.text);
        build/src/A65C0.c.o(.text);
        build/src/A67A0.c.o(.text);
        build/src/A67B0.c.o(.text);
        build/src/A67C0.c.o(.text);
        build/src/A67D0.c.o(.text);
        build/src/A6A20.c.o(.text);
        build/src/A6A40.c.o(.text);
        build/src/A6A90.c.o(.text);
        build/src/A6B40.c.o(.text);
        build/src/A6C30.c.o(.text);
        build/src/A6DE0.c.o(.text);
        build/src/A6E00.c.o(.text);
        build/src/A6ED0.c.o(.text);
        build/src/A6FF0.c.o(.text);
        build/src/A70B0.c.o(.text);
        build/src/A70F0.c.o(.text);
        build/src/A7140.c.o(.text);
        build/src/A71D0.c.o(.text);
        build/src/A7270.c.o(.text);
        build/src/A7570.c.o(.text);
        build/src/A7630.c.o(.text);
        build/src/A7670.c.o(.text);
        build/src/A76B0.c.o(.text);
        build/src/A79F0.c.o(.text);
        build/src/A7A50.c.o(.text);
        build/src/A7AA0.c.o(.text);
        build/src/A7C10.c.o(.text);
        build/src/A7C60.c.o(.text);
        build/src/A7CB0.c.o(.text);
        build/src/A7FC0.c.o(.text);
        build/src/A8020.c.o(.text);
        build/src/A83B0.c.o(.text);
        build/src/A8420.c.o(.text);
        build/src/A8610.c.o(.text);
        build/src/A8880.c.o(.text);
        build/src/A88A0.c.o(.text);
        build/src/A8C30.c.o(.text);
        build/src/A8EE0.c.o(.text);
        build/src/A9140.c.o(.text);
        build/src/A92B0.c.o(.text);
        build/src/A92D0.c.o(.text);
        build/src/A9B00.c.o(.text);
        build/src/AA610.c.o(.text);
        build/src/AA720.c.o(.text);
        build/src/AB3F0.c.o(.text);
        build/src/AB810.c.o(.text);
        build/src/AC3B0.c.o(.text);
        build/src/ADE20.c.o(.text);
        build/src/ADE30.c.o(.text);
        build/src/ADE40.c.o(.text);
        build/src/ADEF0.c.o(.text);
        build/src/AE950.c.o(.text);
        build/src/AE960.c.o(.text);
        build/src/AE970.c.o(.text);
        build/src/AE9B0.c.o(.text);
        build/src/AEA90.c.o(.text);
        build/src/AEAE0.c.o(.text);
        build/src/AEB30.c.o(.text);
        build/src/AEC20.c.o(.text);
        build/src/AEC80.c.o(.text);
        build/src/AECD0.c.o(.text);
        build/src/AEDE0.c.o(.text);
        build/src/AEDF0.c.o(.text);
        build/src/AF0D0.c.o(.text);
        build/src/AF2E0.c.o(.text);
        build/src/AFD70.c.o(.text);
        build/src/B0360.c.o(.text);
        build/src/B1150.c.o(.text);
        build/src/B1170.c.o(.text);
        build/src/B1330.c.o(.text);
        build/src/B1350.c.o(.text);
        build/src/B14D0.c.o(.text);
        build/src/B1910.c.o(.text);
        build/src/B1AF0.c.o(.text);
        build/src/B1BC0.c.o(.text);
        build/src/B1CE0.c.o(.text);
        build/src/B1DB0.c.o(.text);
        build/src/B2020.c.o(.text);
        build/src/B2310.c.o(.text);
        build/src/B2410.c.o(.text);
        build/src/B2420.c.o(.text);
        build/src/B2430.c.o(.text);
        build/src/B2470.c.o(.text);
        build/src/B24A0.c.o(.text);
        build/src/B2800.c.o(.text);
        build/src/B2870.c.o(.text);
        build/src/B28C0.c.o(.text);
        build/src/B2C60.c.o(.text);
        build/src/B3000.c.o(.text);
        build/src/B3700.c.o(.text);
        build/src/B3AA0.c.o(.text);
        build/src/B3B20.c.o(.text);
        build/src/B3B70.c.o(.text);
        build/src/B3BB0.c.o(.text);
        build/src/B3BF0.c.o(.text);
        build/src/B3C20.c.o(.text);
        build/src/B3C40.c.o(.text);
        build/src/B3CD0.c.o(.text);
        build/src/B3D90.c.o(.text);
        build/src/B3DC0.c.o(.text);
        build/src/B3E00.c.o(.text);
        build/src/B3E40.c.o(.text);
        build/src/B3EC0.c.o(.text);
        build/src/B3F80.c.o(.text);
        build/src/B3FB0.c.o(.text);
        build/src/B3FE0.c.o(.text);
        build/src/B4070.c.o(.text);
        build/src/B40B0.c.o(.text);
        build/src/B41E0.c.o(.text);
        build/src/B4340.c.o(.text);
        build/src/B4380.c.o(.text);
        build/src/B43C0.c.o(.text);
        build/src/B4420.c.o(.text);
        build/src/B4470.c.o(.text);
        build/src/B4500.c.o(.text);
        build/src/B45F0.c.o(.text);
        build/src/B4680.c.o(.text);
        build/src/B4780.c.o(.text);
        build/src/B4810.c.o(.text);
        build/src/B4910.c.o(.text);
        build/src/B4B40.c.o(.text);
        build/src/B4CB0.c.o(.text);
        build/src/B50B0.c.o(.text);
        build/src/B5650.c.o(.text);
        build/src/B5A00.c.o(.text);
        build/src/B5B90.c.o(.text);
        build/src/B6270.c.o(.text);
        build/src/B6930.c.o(.text);
        build/src/B6E80.c.o(.text);
        build/src/B6EE0.c.o(.text);
        build/src/B6F40.c.o(.text);
        build/src/B6FB0.c.o(.text);
        build/src/B7010.c.o(.text);
        build/src/B7610.c.o(.text);
        build/src/B77A0.c.o(.text);
        build/src/B7920.c.o(.text);
        build/src/B7B50.c.o(.text);
        build/src/B7EB0.c.o(.text);
        build/src/B8490.c.o(.text);
        build/src/B8640.c.o(.text);
        build/src/B87C0.c.o(.text);
        build/src/B8920.c.o(.text);
        main_TEXT_END = .;
        main_DATA_START = .;
        _1000_s = .;
        build/asm/1000.s.o(.data);
        B6E0_c = .;
        build/src/B6E0.c.o(.data);
        C8E0_c = .;
        build/src/C8E0.c.o(.data);
        ECC0_c = .;
        build/src/ECC0.c.o(.data);
        ECE0_c = .;
        build/src/ECE0.c.o(.data);
        _169B0_c = .;
        build/src/169B0.c.o(.data);
        _17EF0_c = .;
        build/src/17EF0.c.o(.data);
        _187C0_c = .;
        build/src/187C0.c.o(.data);
        _19630_c = .;
        build/src/19630.c.o(.data);
        _19A30_c = .;
        build/src/19A30.c.o(.data);
        _19BF0_c = .;
        build/src/19BF0.c.o(.data);
        _1AE60_c = .;
        build/src/1AE60.c.o(.data);
        _1B8D0_c = .;
        build/src/1B8D0.c.o(.data);
        _1C7C0_c = .;
        build/src/1C7C0.c.o(.data);
        _1D0B0_c = .;
        build/src/1D0B0.c.o(.data);
        _20C70_c = .;
        build/src/20C70.c.o(.data);
        _21920_c = .;
        build/src/21920.c.o(.data);
        _26370_c = .;
        build/src/26370.c.o(.data);
        _274D0_c = .;
        build/src/274D0.c.o(.data);
        _2E0D0_c = .;
        build/src/2E0D0.c.o(.data);
        _30560_c = .;
        build/src/30560.c.o(.data);
        _3D4E0_c = .;
        build/src/3D4E0.c.o(.data);
        _3D6A0_c = .;
        build/src/3D6A0.c.o(.data);
        _415E0_c = .;
        build/src/415E0.c.o(.data);
        _426A0_c = .;
        build/src/426A0.c.o(.data);
        _437E0_c = .;
        build/src/437E0.c.o(.data);
        _43E90_c = .;
        build/src/43E90.c.o(.data);
        _45400_c = .;
        build/src/45400.c.o(.data);
        _459D0_c = .;
        build/src/459D0.c.o(.data);
        _46250_c = .;
        build/src/46250.c.o(.data);
        _4A500_c = .;
        build/src/4A500.c.o(.data);
        _4ABB0_c = .;
        build/src/4ABB0.c.o(.data);
        _4D660_c = .;
        build/src/4D660.c.o(.data);
        _4F650_c = .;
        build/src/4F650.c.o(.data);
        _50E70_c = .;
        build/src/50E70.c.o(.data);
        _512A0_c = .;
        build/src/512A0.c.o(.data);
        _51630_c = .;
        build/src/51630.c.o(.data);
        _54CB0_c = .;
        build/src/54CB0.c.o(.data);
        _565E0_c = .;
        build/src/565E0.c.o(.data);
        _57150_c = .;
        build/src/57150.c.o(.data);
        _58080_c = .;
        build/src/58080.c.o(.data);
        _5EF10_c = .;
        build/src/5EF10.c.o(.data);
        _5F3B0_c = .;
        build/src/5F3B0.c.o(.data);
        _63670_c = .;
        build/src/63670.c.o(.data);
        _67FA0_c = .;
        build/src/67FA0.c.o(.data);
        _68990_c = .;
        build/src/68990.c.o(.data);
        _69060_c = .;
        build/src/69060.c.o(.data);
        _69950_c = .;
        build/src/69950.c.o(.data);
        _733F0_c = .;
        build/src/733F0.c.o(.data);
        _73BA0_c = .;
        build/src/73BA0.c.o(.data);
        _743F0_c = .;
        build/src/743F0.c.o(.data);
        _74AA0_c = .;
        build/src/74AA0.c.o(.data);
        _76CC0_c = .;
        build/src/76CC0.c.o(.data);
        _7AA60_c = .;
        build/src/7AA60.c.o(.data);
        _7C9A0_c = .;
        build/src/7C9A0.c.o(.data);
        _7CF70_c = .;
        build/src/7CF70.c.o(.data);
        _7D1D0_c = .;
        build/src/7D1D0.c.o(.data);
        _7E850_c = .;
        build/src/7E850.c.o(.data);
        _7FAE0_c = .;
        build/src/7FAE0.c.o(.data);
        _80230_c = .;
        build/src/80230.c.o(.data);
        _84FF0_c = .;
        build/src/84FF0.c.o(.data);
        _8FBB0_c = .;
        build/src/8FBB0.c.o(.data);
        _939A0_c = .;
        build/src/939A0.c.o(.data);
        _93A80_c = .;
        build/src/93A80.c.o(.data);
        _978F0_c = .;
        build/src/978F0.c.o(.data);
        _97D60_c = .;
        build/src/97D60.c.o(.data);
        _99370_c = .;
        build/src/99370.c.o(.data);
        _995C0_c = .;
        build/src/995C0.c.o(.data);
        _99690_c = .;
        build/src/99690.c.o(.data);
        _997E0_c = .;
        build/src/997E0.c.o(.data);
        _998D0_c = .;
        build/src/998D0.c.o(.data);
        _99D50_c = .;
        build/src/99D50.c.o(.data);
        _99FE0_c = .;
        build/src/99FE0.c.o(.data);
        _9A210_c = .;
        build/src/9A210.c.o(.data);
        _9B990_c = .;
        build/src/9B990.c.o(.data);
        _9BAF0_c = .;
        build/src/9BAF0.c.o(.data);
        _9BBE0_c = .;
        build/src/9BBE0.c.o(.data);
        _9BC80_c = .;
        build/src/9BC80.c.o(.data);
        _9BE10_c = .;
        build/src/9BE10.c.o(.data);
        _9BFD0_c = .;
        build/src/9BFD0.c.o(.data);
        _9C070_c = .;
        build/src/9C070.c.o(.data);
        _9C410_c = .;
        build/src/9C410.c.o(.data);
        _9C540_c = .;
        build/src/9C540.c.o(.data);
        _9CA50_c = .;
        build/src/9CA50.c.o(.data);
        _9D1C0_c = .;
        build/src/9D1C0.c.o(.data);
        _9D320_c = .;
        build/src/9D320.c.o(.data);
        _9D6D0_c = .;
        build/src/9D6D0.c.o(.data);
        _9D750_c = .;
        build/src/9D750.c.o(.data);
        _9D840_c = .;
        build/src/9D840.c.o(.data);
        _9D8C0_c = .;
        build/src/9D8C0.c.o(.data);
        _9E2C0_c = .;
        build/src/9E2C0.c.o(.data);
        _9E740_c = .;
        build/src/9E740.c.o(.data);
        _9E7A0_c = .;
        build/src/9E7A0.c.o(.data);
        _9E800_c = .;
        build/src/9E800.c.o(.data);
        _9E8A0_c = .;
        build/src/9E8A0.c.o(.data);
        _9EA20_c = .;
        build/src/9EA20.c.o(.data);
        _9EDE0_c = .;
        build/src/9EDE0.c.o(.data);
        _9EED0_c = .;
        build/src/9EED0.c.o(.data);
        _9F000_c = .;
        build/src/9F000.c.o(.data);
        _9F0A0_c = .;
        build/src/9F0A0.c.o(.data);
        _9F6C0_c = .;
        build/src/9F6C0.c.o(.data);
        _9F770_c = .;
        build/src/9F770.c.o(.data);
        _9F7B0_c = .;
        build/src/9F7B0.c.o(.data);
        _9F800_c = .;
        build/src/9F800.c.o(.data);
        _9F840_c = .;
        build/src/9F840.c.o(.data);
        A0340_c = .;
        build/src/A0340.c.o(.data);
        A0360_c = .;
        build/src/A0360.c.o(.data);
        A0380_c = .;
        build/src/A0380.c.o(.data);
        A0400_c = .;
        build/src/A0400.c.o(.data);
        A0430_c = .;
        build/src/A0430.c.o(.data);
        A0440_c = .;
        build/src/A0440.c.o(.data);
        A0470_c = .;
        build/src/A0470.c.o(.data);
        A0580_c = .;
        build/src/A0580.c.o(.data);
        A17E0_c = .;
        build/src/A17E0.c.o(.data);
        A1810_c = .;
        build/src/A1810.c.o(.data);
        A18D0_c = .;
        build/src/A18D0.c.o(.data);
        A1920_c = .;
        build/src/A1920.c.o(.data);
        A19E0_c = .;
        build/src/A19E0.c.o(.data);
        A1A50_c = .;
        build/src/A1A50.c.o(.data);
        A1A80_c = .;
        build/src/A1A80.c.o(.data);
        A1AD0_c = .;
        build/src/A1AD0.c.o(.data);
        A1B20_c = .;
        build/src/A1B20.c.o(.data);
        A1B70_c = .;
        build/src/A1B70.c.o(.data);
        A21B0_c = .;
        build/src/A21B0.c.o(.data);
        A21C0_c = .;
        build/src/A21C0.c.o(.data);
        A22B0_c = .;
        build/src/A22B0.c.o(.data);
        A2350_c = .;
        build/src/A2350.c.o(.data);
        A25B0_c = .;
        build/src/A25B0.c.o(.data);
        A2650_c = .;
        build/src/A2650.c.o(.data);
        A27A0_c = .;
        build/src/A27A0.c.o(.data);
        A28E0_c = .;
        build/src/A28E0.c.o(.data);
        A2940_c = .;
        build/src/A2940.c.o(.data);
        A2A70_c = .;
        build/src/A2A70.c.o(.data);
        A2AF0_c = .;
        build/src/A2AF0.c.o(.data);
        A2B20_c = .;
        build/src/A2B20.c.o(.data);
        A2D00_c = .;
        build/src/A2D00.c.o(.data);
        A3010_c = .;
        build/src/A3010.c.o(.data);
        A30D0_c = .;
        build/src/A30D0.c.o(.data);
        A3930_c = .;
        build/src/A3930.c.o(.data);
        A4390_c = .;
        build/src/A4390.c.o(.data);
        A4980_c = .;
        build/src/A4980.c.o(.data);
        A4B10_c = .;
        build/src/A4B10.c.o(.data);
        A5110_c = .;
        build/src/A5110.c.o(.data);
        A5490_c = .;
        build/src/A5490.c.o(.data);
        A54C0_c = .;
        build/src/A54C0.c.o(.data);
        A57A0_c = .;
        build/src/A57A0.c.o(.data);
        A5AC0_c = .;
        build/src/A5AC0.c.o(.data);
        A5BA0_c = .;
        build/src/A5BA0.c.o(.data);
        A5E10_c = .;
        build/src/A5E10.c.o(.data);
        A6260_c = .;
        build/src/A6260.c.o(.data);
        A62F0_c = .;
        build/src/A62F0.c.o(.data);
        A6320_c = .;
        build/src/A6320.c.o(.data);
        A6350_c = .;
        build/src/A6350.c.o(.data);
        A6490_c = .;
        build/src/A6490.c.o(.data);
        A65C0_c = .;
        build/src/A65C0.c.o(.data);
        A67A0_c = .;
        build/src/A67A0.c.o(.data);
        A67B0_c = .;
        build/src/A67B0.c.o(.data);
        A67C0_c = .;
        build/src/A67C0.c.o(.data);
        A67D0_c = .;
        build/src/A67D0.c.o(.data);
        A6A20_c = .;
        build/src/A6A20.c.o(.data);
        A6A40_c = .;
        build/src/A6A40.c.o(.data);
        A6A90_c = .;
        build/src/A6A90.c.o(.data);
        A6B40_c = .;
        build/src/A6B40.c.o(.data);
        A6C30_c = .;
        build/src/A6C30.c.o(.data);
        A6DE0_c = .;
        build/src/A6DE0.c.o(.data);
        A6E00_c = .;
        build/src/A6E00.c.o(.data);
        A6ED0_c = .;
        build/src/A6ED0.c.o(.data);
        A6FF0_c = .;
        build/src/A6FF0.c.o(.data);
        A70B0_c = .;
        build/src/A70B0.c.o(.data);
        A70F0_c = .;
        build/src/A70F0.c.o(.data);
        A7140_c = .;
        build/src/A7140.c.o(.data);
        A71D0_c = .;
        build/src/A71D0.c.o(.data);
        A7270_c = .;
        build/src/A7270.c.o(.data);
        A7570_c = .;
        build/src/A7570.c.o(.data);
        A7630_c = .;
        build/src/A7630.c.o(.data);
        A7670_c = .;
        build/src/A7670.c.o(.data);
        A76B0_c = .;
        build/src/A76B0.c.o(.data);
        A79F0_c = .;
        build/src/A79F0.c.o(.data);
        A7A50_c = .;
        build/src/A7A50.c.o(.data);
        A7AA0_c = .;
        build/src/A7AA0.c.o(.data);
        A7C10_c = .;
        build/src/A7C10.c.o(.data);
        A7C60_c = .;
        build/src/A7C60.c.o(.data);
        A7CB0_c = .;
        build/src/A7CB0.c.o(.data);
        A7FC0_c = .;
        build/src/A7FC0.c.o(.data);
        A8020_c = .;
        build/src/A8020.c.o(.data);
        A83B0_c = .;
        build/src/A83B0.c.o(.data);
        A8420_c = .;
        build/src/A8420.c.o(.data);
        A8610_c = .;
        build/src/A8610.c.o(.data);
        A8880_c = .;
        build/src/A8880.c.o(.data);
        A88A0_c = .;
        build/src/A88A0.c.o(.data);
        A8C30_c = .;
        build/src/A8C30.c.o(.data);
        A8EE0_c = .;
        build/src/A8EE0.c.o(.data);
        A9140_c = .;
        build/src/A9140.c.o(.data);
        A92B0_c = .;
        build/src/A92B0.c.o(.data);
        A92D0_c = .;
        build/src/A92D0.c.o(.data);
        A9B00_c = .;
        build/src/A9B00.c.o(.data);
        AA610_c = .;
        build/src/AA610.c.o(.data);
        AA720_c = .;
        build/src/AA720.c.o(.data);
        AB3F0_c = .;
        build/src/AB3F0.c.o(.data);
        AB810_c = .;
        build/src/AB810.c.o(.data);
        AC3B0_c = .;
        build/src/AC3B0.c.o(.data);
        ADE20_c = .;
        build/src/ADE20.c.o(.data);
        ADE30_c = .;
        build/src/ADE30.c.o(.data);
        ADE40_c = .;
        build/src/ADE40.c.o(.data);
        ADEF0_c = .;
        build/src/ADEF0.c.o(.data);
        AE950_c = .;
        build/src/AE950.c.o(.data);
        AE960_c = .;
        build/src/AE960.c.o(.data);
        AE970_c = .;
        build/src/AE970.c.o(.data);
        AE9B0_c = .;
        build/src/AE9B0.c.o(.data);
        AEA90_c = .;
        build/src/AEA90.c.o(.data);
        AEAE0_c = .;
        build/src/AEAE0.c.o(.data);
        AEB30_c = .;
        build/src/AEB30.c.o(.data);
        AEC20_c = .;
        build/src/AEC20.c.o(.data);
        AEC80_c = .;
        build/src/AEC80.c.o(.data);
        AECD0_c = .;
        build/src/AECD0.c.o(.data);
        AEDE0_c = .;
        build/src/AEDE0.c.o(.data);
        AEDF0_c = .;
        build/src/AEDF0.c.o(.data);
        AF0D0_c = .;
        build/src/AF0D0.c.o(.data);
        AF2E0_c = .;
        build/src/AF2E0.c.o(.data);
        AFD70_c = .;
        build/src/AFD70.c.o(.data);
        B0360_c = .;
        build/src/B0360.c.o(.data);
        B1150_c = .;
        build/src/B1150.c.o(.data);
        B1170_c = .;
        build/src/B1170.c.o(.data);
        B1330_c = .;
        build/src/B1330.c.o(.data);
        B1350_c = .;
        build/src/B1350.c.o(.data);
        B14D0_c = .;
        build/src/B14D0.c.o(.data);
        B1910_c = .;
        build/src/B1910.c.o(.data);
        B1AF0_c = .;
        build/src/B1AF0.c.o(.data);
        B1BC0_c = .;
        build/src/B1BC0.c.o(.data);
        B1CE0_c = .;
        build/src/B1CE0.c.o(.data);
        B1DB0_c = .;
        build/src/B1DB0.c.o(.data);
        B2020_c = .;
        build/src/B2020.c.o(.data);
        B2310_c = .;
        build/src/B2310.c.o(.data);
        B2410_c = .;
        build/src/B2410.c.o(.data);
        B2420_c = .;
        build/src/B2420.c.o(.data);
        B2430_c = .;
        build/src/B2430.c.o(.data);
        B2470_c = .;
        build/src/B2470.c.o(.data);
        B24A0_c = .;
        build/src/B24A0.c.o(.data);
        B2800_c = .;
        build/src/B2800.c.o(.data);
        B2870_c = .;
        build/src/B2870.c.o(.data);
        B28C0_c = .;
        build/src/B28C0.c.o(.data);
        B2C60_c = .;
        build/src/B2C60.c.o(.data);
        B3000_c = .;
        build/src/B3000.c.o(.data);
        B3700_c = .;
        build/src/B3700.c.o(.data);
        B3AA0_c = .;
        build/src/B3AA0.c.o(.data);
        B3B20_c = .;
        build/src/B3B20.c.o(.data);
        B3B70_c = .;
        build/src/B3B70.c.o(.data);
        B3BB0_c = .;
        build/src/B3BB0.c.o(.data);
        B3BF0_c = .;
        build/src/B3BF0.c.o(.data);
        B3C20_c = .;
        build/src/B3C20.c.o(.data);
        B3C40_c = .;
        build/src/B3C40.c.o(.data);
        B3CD0_c = .;
        build/src/B3CD0.c.o(.data);
        B3D90_c = .;
        build/src/B3D90.c.o(.data);
        B3DC0_c = .;
        build/src/B3DC0.c.o(.data);
        B3E00_c = .;
        build/src/B3E00.c.o(.data);
        B3E40_c = .;
        build/src/B3E40.c.o(.data);
        B3EC0_c = .;
        build/src/B3EC0.c.o(.data);
        B3F80_c = .;
        build/src/B3F80.c.o(.data);
        B3FB0_c = .;
        build/src/B3FB0.c.o(.data);
        B3FE0_c = .;
        build/src/B3FE0.c.o(.data);
        B4070_c = .;
        build/src/B4070.c.o(.data);
        B40B0_c = .;
        build/src/B40B0.c.o(.data);
        B41E0_c = .;
        build/src/B41E0.c.o(.data);
        B4340_c = .;
        build/src/B4340.c.o(.data);
        B4380_c = .;
        build/src/B4380.c.o(.data);
        B43C0_c = .;
        build/src/B43C0.c.o(.data);
        B4420_c = .;
        build/src/B4420.c.o(.data);
        B4470_c = .;
        build/src/B4470.c.o(.data);
        B4500_c = .;
        build/src/B4500.c.o(.data);
        B45F0_c = .;
        build/src/B45F0.c.o(.data);
        B4680_c = .;
        build/src/B4680.c.o(.data);
        B4780_c = .;
        build/src/B4780.c.o(.data);
        B4810_c = .;
        build/src/B4810.c.o(.data);
        B4910_c = .;
        build/src/B4910.c.o(.data);
        B4B40_c = .;
        build/src/B4B40.c.o(.data);
        B4CB0_c = .;
        build/src/B4CB0.c.o(.data);
        B50B0_c = .;
        build/src/B50B0.c.o(.data);
        B5650_c = .;
        build/src/B5650.c.o(.data);
        B5A00_c = .;
        build/src/B5A00.c.o(.data);
        B5B90_c = .;
        build/src/B5B90.c.o(.data);
        B6270_c = .;
        build/src/B6270.c.o(.data);
        B6930_c = .;
        build/src/B6930.c.o(.data);
        B6E80_c = .;
        build/src/B6E80.c.o(.data);
        B6EE0_c = .;
        build/src/B6EE0.c.o(.data);
        B6F40_c = .;
        build/src/B6F40.c.o(.data);
        B6FB0_c = .;
        build/src/B6FB0.c.o(.data);
        B7010_c = .;
        build/src/B7010.c.o(.data);
        B7610_c = .;
        build/src/B7610.c.o(.data);
        B77A0_c = .;
        build/src/B77A0.c.o(.data);
        B7920_c = .;
        build/src/B7920.c.o(.data);
        B7B50_c = .;
        build/src/B7B50.c.o(.data);
        B7EB0_c = .;
        build/src/B7EB0.c.o(.data);
        B8490_c = .;
        build/src/B8490.c.o(.data);
        B8640_c = .;
        build/src/B8640.c.o(.data);
        B87C0_c = .;
        build/src/B87C0.c.o(.data);
        B8920_c = .;
        build/src/B8920.c.o(.data);
        build/asm/1000.s.o(.rodata);
        build/src/B6E0.c.o(.rodata);
        build/src/C8E0.c.o(.rodata);
        build/src/ECC0.c.o(.rodata);
        build/src/ECE0.c.o(.rodata);
        build/src/169B0.c.o(.rodata);
        build/src/17EF0.c.o(.rodata);
        build/src/187C0.c.o(.rodata);
        build/src/19630.c.o(.rodata);
        build/src/19A30.c.o(.rodata);
        build/src/19BF0.c.o(.rodata);
        build/src/1AE60.c.o(.rodata);
        build/src/1B8D0.c.o(.rodata);
        build/src/1C7C0.c.o(.rodata);
        build/src/1D0B0.c.o(.rodata);
        build/src/20C70.c.o(.rodata);
        build/src/21920.c.o(.rodata);
        build/src/26370.c.o(.rodata);
        build/src/274D0.c.o(.rodata);
        build/src/2E0D0.c.o(.rodata);
        build/src/30560.c.o(.rodata);
        build/src/3D4E0.c.o(.rodata);
        build/src/3D6A0.c.o(.rodata);
        build/src/415E0.c.o(.rodata);
        build/src/426A0.c.o(.rodata);
        build/src/437E0.c.o(.rodata);
        build/src/43E90.c.o(.rodata);
        build/src/45400.c.o(.rodata);
        build/src/459D0.c.o(.rodata);
        build/src/46250.c.o(.rodata);
        build/src/4A500.c.o(.rodata);
        build/src/4ABB0.c.o(.rodata);
        build/src/4D660.c.o(.rodata);
        build/src/4F650.c.o(.rodata);
        build/src/50E70.c.o(.rodata);
        build/src/512A0.c.o(.rodata);
        build/src/51630.c.o(.rodata);
        build/src/54CB0.c.o(.rodata);
        build/src/565E0.c.o(.rodata);
        build/src/57150.c.o(.rodata);
        build/src/58080.c.o(.rodata);
        build/src/5EF10.c.o(.rodata);
        build/src/5F3B0.c.o(.rodata);
        build/src/63670.c.o(.rodata);
        build/src/67FA0.c.o(.rodata);
        build/src/68990.c.o(.rodata);
        build/src/69060.c.o(.rodata);
        build/src/69950.c.o(.rodata);
        build/src/733F0.c.o(.rodata);
        build/src/73BA0.c.o(.rodata);
        build/src/743F0.c.o(.rodata);
        build/src/74AA0.c.o(.rodata);
        build/src/76CC0.c.o(.rodata);
        build/src/7AA60.c.o(.rodata);
        build/src/7C9A0.c.o(.rodata);
        build/src/7CF70.c.o(.rodata);
        build/src/7D1D0.c.o(.rodata);
        build/src/7E850.c.o(.rodata);
        build/src/7FAE0.c.o(.rodata);
        build/src/80230.c.o(.rodata);
        build/src/84FF0.c.o(.rodata);
        build/src/8FBB0.c.o(.rodata);
        build/src/939A0.c.o(.rodata);
        build/src/93A80.c.o(.rodata);
        build/src/978F0.c.o(.rodata);
        build/src/97D60.c.o(.rodata);
        build/src/99370.c.o(.rodata);
        build/src/995C0.c.o(.rodata);
        build/src/99690.c.o(.rodata);
        build/src/997E0.c.o(.rodata);
        build/src/998D0.c.o(.rodata);
        build/src/99D50.c.o(.rodata);
        build/src/99FE0.c.o(.rodata);
        build/src/9A210.c.o(.rodata);
        build/src/9B990.c.o(.rodata);
        build/src/9BAF0.c.o(.rodata);
        build/src/9BBE0.c.o(.rodata);
        build/src/9BC80.c.o(.rodata);
        build/src/9BE10.c.o(.rodata);
        build/src/9BFD0.c.o(.rodata);
        build/src/9C070.c.o(.rodata);
        build/src/9C410.c.o(.rodata);
        build/src/9C540.c.o(.rodata);
        build/src/9CA50.c.o(.rodata);
        build/src/9D1C0.c.o(.rodata);
        build/src/9D320.c.o(.rodata);
        build/src/9D6D0.c.o(.rodata);
        build/src/9D750.c.o(.rodata);
        build/src/9D840.c.o(.rodata);
        build/src/9D8C0.c.o(.rodata);
        build/src/9E2C0.c.o(.rodata);
        build/src/9E740.c.o(.rodata);
        build/src/9E7A0.c.o(.rodata);
        build/src/9E800.c.o(.rodata);
        build/src/9E8A0.c.o(.rodata);
        build/src/9EA20.c.o(.rodata);
        build/src/9EDE0.c.o(.rodata);
        build/src/9EED0.c.o(.rodata);
        build/src/9F000.c.o(.rodata);
        build/src/9F0A0.c.o(.rodata);
        build/src/9F6C0.c.o(.rodata);
        build/src/9F770.c.o(.rodata);
        build/src/9F7B0.c.o(.rodata);
        build/src/9F800.c.o(.rodata);
        build/src/9F840.c.o(.rodata);
        build/src/A0340.c.o(.rodata);
        build/src/A0360.c.o(.rodata);
        build/src/A0380.c.o(.rodata);
        build/src/A0400.c.o(.rodata);
        build/src/A0430.c.o(.rodata);
        build/src/A0440.c.o(.rodata);
        build/src/A0470.c.o(.rodata);
        build/src/A0580.c.o(.rodata);
        build/src/A17E0.c.o(.rodata);
        build/src/A1810.c.o(.rodata);
        build/src/A18D0.c.o(.rodata);
        build/src/A1920.c.o(.rodata);
        build/src/A19E0.c.o(.rodata);
        build/src/A1A50.c.o(.rodata);
        build/src/A1A80.c.o(.rodata);
        build/src/A1AD0.c.o(.rodata);
        build/src/A1B20.c.o(.rodata);
        build/src/A1B70.c.o(.rodata);
        build/src/A21B0.c.o(.rodata);
        build/src/A21C0.c.o(.rodata);
        build/src/A22B0.c.o(.rodata);
        build/src/A2350.c.o(.rodata);
        build/src/A25B0.c.o(.rodata);
        build/src/A2650.c.o(.rodata);
        build/src/A27A0.c.o(.rodata);
        build/src/A28E0.c.o(.rodata);
        build/src/A2940.c.o(.rodata);
        build/src/A2A70.c.o(.rodata);
        build/src/A2AF0.c.o(.rodata);
        build/src/A2B20.c.o(.rodata);
        build/src/A2D00.c.o(.rodata);
        build/src/A3010.c.o(.rodata);
        build/src/A30D0.c.o(.rodata);
        build/src/A3930.c.o(.rodata);
        build/src/A4390.c.o(.rodata);
        build/src/A4980.c.o(.rodata);
        build/src/A4B10.c.o(.rodata);
        build/src/A5110.c.o(.rodata);
        build/src/A5490.c.o(.rodata);
        build/src/A54C0.c.o(.rodata);
        build/src/A57A0.c.o(.rodata);
        build/src/A5AC0.c.o(.rodata);
        build/src/A5BA0.c.o(.rodata);
        build/src/A5E10.c.o(.rodata);
        build/src/A6260.c.o(.rodata);
        build/src/A62F0.c.o(.rodata);
        build/src/A6320.c.o(.rodata);
        build/src/A6350.c.o(.rodata);
        build/src/A6490.c.o(.rodata);
        build/src/A65C0.c.o(.rodata);
        build/src/A67A0.c.o(.rodata);
        build/src/A67B0.c.o(.rodata);
        build/src/A67C0.c.o(.rodata);
        build/src/A67D0.c.o(.rodata);
        build/src/A6A20.c.o(.rodata);
        build/src/A6A40.c.o(.rodata);
        build/src/A6A90.c.o(.rodata);
        build/src/A6B40.c.o(.rodata);
        build/src/A6C30.c.o(.rodata);
        build/src/A6DE0.c.o(.rodata);
        build/src/A6E00.c.o(.rodata);
        build/src/A6ED0.c.o(.rodata);
        build/src/A6FF0.c.o(.rodata);
        build/src/A70B0.c.o(.rodata);
        build/src/A70F0.c.o(.rodata);
        build/src/A7140.c.o(.rodata);
        build/src/A71D0.c.o(.rodata);
        build/src/A7270.c.o(.rodata);
        build/src/A7570.c.o(.rodata);
        build/src/A7630.c.o(.rodata);
        build/src/A7670.c.o(.rodata);
        build/src/A76B0.c.o(.rodata);
        build/src/A79F0.c.o(.rodata);
        build/src/A7A50.c.o(.rodata);
        build/src/A7AA0.c.o(.rodata);
        build/src/A7C10.c.o(.rodata);
        build/src/A7C60.c.o(.rodata);
        build/src/A7CB0.c.o(.rodata);
        build/src/A7FC0.c.o(.rodata);
        build/src/A8020.c.o(.rodata);
        build/src/A83B0.c.o(.rodata);
        build/src/A8420.c.o(.rodata);
        build/src/A8610.c.o(.rodata);
        build/src/A8880.c.o(.rodata);
        build/src/A88A0.c.o(.rodata);
        build/src/A8C30.c.o(.rodata);
        build/src/A8EE0.c.o(.rodata);
        build/src/A9140.c.o(.rodata);
        build/src/A92B0.c.o(.rodata);
        build/src/A92D0.c.o(.rodata);
        build/src/A9B00.c.o(.rodata);
        build/src/AA610.c.o(.rodata);
        build/src/AA720.c.o(.rodata);
        build/src/AB3F0.c.o(.rodata);
        build/src/AB810.c.o(.rodata);
        build/src/AC3B0.c.o(.rodata);
        build/src/ADE20.c.o(.rodata);
        build/src/ADE30.c.o(.rodata);
        build/src/ADE40.c.o(.rodata);
        build/src/ADEF0.c.o(.rodata);
        build/src/AE950.c.o(.rodata);
        build/src/AE960.c.o(.rodata);
        build/src/AE970.c.o(.rodata);
        build/src/AE9B0.c.o(.rodata);
        build/src/AEA90.c.o(.rodata);
        build/src/AEAE0.c.o(.rodata);
        build/src/AEB30.c.o(.rodata);
        build/src/AEC20.c.o(.rodata);
        build/src/AEC80.c.o(.rodata);
        build/src/AECD0.c.o(.rodata);
        build/src/AEDE0.c.o(.rodata);
        build/src/AEDF0.c.o(.rodata);
        build/src/AF0D0.c.o(.rodata);
        build/src/AF2E0.c.o(.rodata);
        build/src/AFD70.c.o(.rodata);
        build/src/B0360.c.o(.rodata);
        build/src/B1150.c.o(.rodata);
        build/src/B1170.c.o(.rodata);
        build/src/B1330.c.o(.rodata);
        build/src/B1350.c.o(.rodata);
        build/src/B14D0.c.o(.rodata);
        build/src/B1910.c.o(.rodata);
        build/src/B1AF0.c.o(.rodata);
        build/src/B1BC0.c.o(.rodata);
        build/src/B1CE0.c.o(.rodata);
        build/src/B1DB0.c.o(.rodata);
        build/src/B2020.c.o(.rodata);
        build/src/B2310.c.o(.rodata);
        build/src/B2410.c.o(.rodata);
        build/src/B2420.c.o(.rodata);
        build/src/B2430.c.o(.rodata);
        build/src/B2470.c.o(.rodata);
        build/src/B24A0.c.o(.rodata);
        build/src/B2800.c.o(.rodata);
        build/src/B2870.c.o(.rodata);
        build/src/B28C0.c.o(.rodata);
        build/src/B2C60.c.o(.rodata);
        build/src/B3000.c.o(.rodata);
        build/src/B3700.c.o(.rodata);
        build/src/B3AA0.c.o(.rodata);
        build/src/B3B20.c.o(.rodata);
        build/src/B3B70.c.o(.rodata);
        build/src/B3BB0.c.o(.rodata);
        build/src/B3BF0.c.o(.rodata);
        build/src/B3C20.c.o(.rodata);
        build/src/B3C40.c.o(.rodata);
        build/src/B3CD0.c.o(.rodata);
        build/src/B3D90.c.o(.rodata);
        build/src/B3DC0.c.o(.rodata);
        build/src/B3E00.c.o(.rodata);
        build/src/B3E40.c.o(.rodata);
        build/src/B3EC0.c.o(.rodata);
        build/src/B3F80.c.o(.rodata);
        build/src/B3FB0.c.o(.rodata);
        build/src/B3FE0.c.o(.rodata);
        build/src/B4070.c.o(.rodata);
        build/src/B40B0.c.o(.rodata);
        build/src/B41E0.c.o(.rodata);
        build/src/B4340.c.o(.rodata);
        build/src/B4380.c.o(.rodata);
        build/src/B43C0.c.o(.rodata);
        build/src/B4420.c.o(.rodata);
        build/src/B4470.c.o(.rodata);
        build/src/B4500.c.o(.rodata);
        build/src/B45F0.c.o(.rodata);
        build/src/B4680.c.o(.rodata);
        build/src/B4780.c.o(.rodata);
        build/src/B4810.c.o(.rodata);
        build/src/B4910.c.o(.rodata);
        build/src/B4B40.c.o(.rodata);
        build/src/B4CB0.c.o(.rodata);
        build/src/B50B0.c.o(.rodata);
        build/src/B5650.c.o(.rodata);
        build/src/B5A00.c.o(.rodata);
        build/src/B5B90.c.o(.rodata);
        build/src/B6270.c.o(.rodata);
        build/src/B6930.c.o(.rodata);
        build/src/B6E80.c.o(.rodata);
        build/src/B6EE0.c.o(.rodata);
        build/src/B6F40.c.o(.rodata);
        build/src/B6FB0.c.o(.rodata);
        build/src/B7010.c.o(.rodata);
        build/src/B7610.c.o(.rodata);
        build/src/B77A0.c.o(.rodata);
        build/src/B7920.c.o(.rodata);
        build/src/B7B50.c.o(.rodata);
        build/src/B7EB0.c.o(.rodata);
        build/src/B8490.c.o(.rodata);
        build/src/B8640.c.o(.rodata);
        build/src/B87C0.c.o(.rodata);
        build/src/B8920.c.o(.rodata);
        main_DATA_END = .;
        main_BSS_START = .;
        build/asm/1000.s.o(.bss);
        build/src/B6E0.c.o(.bss);
        build/src/C8E0.c.o(.bss);
        build/src/ECC0.c.o(.bss);
        build/src/ECE0.c.o(.bss);
        build/src/169B0.c.o(.bss);
        build/src/17EF0.c.o(.bss);
        build/src/187C0.c.o(.bss);
        build/src/19630.c.o(.bss);
        build/src/19A30.c.o(.bss);
        build/src/19BF0.c.o(.bss);
        build/src/1AE60.c.o(.bss);
        build/src/1B8D0.c.o(.bss);
        build/src/1C7C0.c.o(.bss);
        build/src/1D0B0.c.o(.bss);
        build/src/20C70.c.o(.bss);
        build/src/21920.c.o(.bss);
        build/src/26370.c.o(.bss);
        build/src/274D0.c.o(.bss);
        build/src/2E0D0.c.o(.bss);
        build/src/30560.c.o(.bss);
        build/src/3D4E0.c.o(.bss);
        build/src/3D6A0.c.o(.bss);
        build/src/415E0.c.o(.bss);
        build/src/426A0.c.o(.bss);
        build/src/437E0.c.o(.bss);
        build/src/43E90.c.o(.bss);
        build/src/45400.c.o(.bss);
        build/src/459D0.c.o(.bss);
        build/src/46250.c.o(.bss);
        build/src/4A500.c.o(.bss);
        build/src/4ABB0.c.o(.bss);
        build/src/4D660.c.o(.bss);
        build/src/4F650.c.o(.bss);
        build/src/50E70.c.o(.bss);
        build/src/512A0.c.o(.bss);
        build/src/51630.c.o(.bss);
        build/src/54CB0.c.o(.bss);
        build/src/565E0.c.o(.bss);
        build/src/57150.c.o(.bss);
        build/src/58080.c.o(.bss);
        build/src/5EF10.c.o(.bss);
        build/src/5F3B0.c.o(.bss);
        build/src/63670.c.o(.bss);
        build/src/67FA0.c.o(.bss);
        build/src/68990.c.o(.bss);
        build/src/69060.c.o(.bss);
        build/src/69950.c.o(.bss);
        build/src/733F0.c.o(.bss);
        build/src/73BA0.c.o(.bss);
        build/src/743F0.c.o(.bss);
        build/src/74AA0.c.o(.bss);
        build/src/76CC0.c.o(.bss);
        build/src/7AA60.c.o(.bss);
        build/src/7C9A0.c.o(.bss);
        build/src/7CF70.c.o(.bss);
        build/src/7D1D0.c.o(.bss);
        build/src/7E850.c.o(.bss);
        build/src/7FAE0.c.o(.bss);
        build/src/80230.c.o(.bss);
        build/src/84FF0.c.o(.bss);
        build/src/8FBB0.c.o(.bss);
        build/src/939A0.c.o(.bss);
        build/src/93A80.c.o(.bss);
        build/src/978F0.c.o(.bss);
        build/src/97D60.c.o(.bss);
        build/src/99370.c.o(.bss);
        build/src/995C0.c.o(.bss);
        build/src/99690.c.o(.bss);
        build/src/997E0.c.o(.bss);
        build/src/998D0.c.o(.bss);
        build/src/99D50.c.o(.bss);
        build/src/99FE0.c.o(.bss);
        build/src/9A210.c.o(.bss);
        build/src/9B990.c.o(.bss);
        build/src/9BAF0.c.o(.bss);
        build/src/9BBE0.c.o(.bss);
        build/src/9BC80.c.o(.bss);
        build/src/9BE10.c.o(.bss);
        build/src/9BFD0.c.o(.bss);
        build/src/9C070.c.o(.bss);
        build/src/9C410.c.o(.bss);
        build/src/9C540.c.o(.bss);
        build/src/9CA50.c.o(.bss);
        build/src/9D1C0.c.o(.bss);
        build/src/9D320.c.o(.bss);
        build/src/9D6D0.c.o(.bss);
        build/src/9D750.c.o(.bss);
        build/src/9D840.c.o(.bss);
        build/src/9D8C0.c.o(.bss);
        build/src/9E2C0.c.o(.bss);
        build/src/9E740.c.o(.bss);
        build/src/9E7A0.c.o(.bss);
        build/src/9E800.c.o(.bss);
        build/src/9E8A0.c.o(.bss);
        build/src/9EA20.c.o(.bss);
        build/src/9EDE0.c.o(.bss);
        build/src/9EED0.c.o(.bss);
        build/src/9F000.c.o(.bss);
        build/src/9F0A0.c.o(.bss);
        build/src/9F6C0.c.o(.bss);
        build/src/9F770.c.o(.bss);
        build/src/9F7B0.c.o(.bss);
        build/src/9F800.c.o(.bss);
        build/src/9F840.c.o(.bss);
        build/src/A0340.c.o(.bss);
        build/src/A0360.c.o(.bss);
        build/src/A0380.c.o(.bss);
        build/src/A0400.c.o(.bss);
        build/src/A0430.c.o(.bss);
        build/src/A0440.c.o(.bss);
        build/src/A0470.c.o(.bss);
        build/src/A0580.c.o(.bss);
        build/src/A17E0.c.o(.bss);
        build/src/A1810.c.o(.bss);
        build/src/A18D0.c.o(.bss);
        build/src/A1920.c.o(.bss);
        build/src/A19E0.c.o(.bss);
        build/src/A1A50.c.o(.bss);
        build/src/A1A80.c.o(.bss);
        build/src/A1AD0.c.o(.bss);
        build/src/A1B20.c.o(.bss);
        build/src/A1B70.c.o(.bss);
        build/src/A21B0.c.o(.bss);
        build/src/A21C0.c.o(.bss);
        build/src/A22B0.c.o(.bss);
        build/src/A2350.c.o(.bss);
        build/src/A25B0.c.o(.bss);
        build/src/A2650.c.o(.bss);
        build/src/A27A0.c.o(.bss);
        build/src/A28E0.c.o(.bss);
        build/src/A2940.c.o(.bss);
        build/src/A2A70.c.o(.bss);
        build/src/A2AF0.c.o(.bss);
        build/src/A2B20.c.o(.bss);
        build/src/A2D00.c.o(.bss);
        build/src/A3010.c.o(.bss);
        build/src/A30D0.c.o(.bss);
        build/src/A3930.c.o(.bss);
        build/src/A4390.c.o(.bss);
        build/src/A4980.c.o(.bss);
        build/src/A4B10.c.o(.bss);
        build/src/A5110.c.o(.bss);
        build/src/A5490.c.o(.bss);
        build/src/A54C0.c.o(.bss);
        build/src/A57A0.c.o(.bss);
        build/src/A5AC0.c.o(.bss);
        build/src/A5BA0.c.o(.bss);
        build/src/A5E10.c.o(.bss);
        build/src/A6260.c.o(.bss);
        build/src/A62F0.c.o(.bss);
        build/src/A6320.c.o(.bss);
        build/src/A6350.c.o(.bss);
        build/src/A6490.c.o(.bss);
        build/src/A65C0.c.o(.bss);
        build/src/A67A0.c.o(.bss);
        build/src/A67B0.c.o(.bss);
        build/src/A67C0.c.o(.bss);
        build/src/A67D0.c.o(.bss);
        build/src/A6A20.c.o(.bss);
        build/src/A6A40.c.o(.bss);
        build/src/A6A90.c.o(.bss);
        build/src/A6B40.c.o(.bss);
        build/src/A6C30.c.o(.bss);
        build/src/A6DE0.c.o(.bss);
        build/src/A6E00.c.o(.bss);
        build/src/A6ED0.c.o(.bss);
        build/src/A6FF0.c.o(.bss);
        build/src/A70B0.c.o(.bss);
        build/src/A70F0.c.o(.bss);
        build/src/A7140.c.o(.bss);
        build/src/A71D0.c.o(.bss);
        build/src/A7270.c.o(.bss);
        build/src/A7570.c.o(.bss);
        build/src/A7630.c.o(.bss);
        build/src/A7670.c.o(.bss);
        build/src/A76B0.c.o(.bss);
        build/src/A79F0.c.o(.bss);
        build/src/A7A50.c.o(.bss);
        build/src/A7AA0.c.o(.bss);
        build/src/A7C10.c.o(.bss);
        build/src/A7C60.c.o(.bss);
        build/src/A7CB0.c.o(.bss);
        build/src/A7FC0.c.o(.bss);
        build/src/A8020.c.o(.bss);
        build/src/A83B0.c.o(.bss);
        build/src/A8420.c.o(.bss);
        build/src/A8610.c.o(.bss);
        build/src/A8880.c.o(.bss);
        build/src/A88A0.c.o(.bss);
        build/src/A8C30.c.o(.bss);
        build/src/A8EE0.c.o(.bss);
        build/src/A9140.c.o(.bss);
        build/src/A92B0.c.o(.bss);
        build/src/A92D0.c.o(.bss);
        build/src/A9B00.c.o(.bss);
        build/src/AA610.c.o(.bss);
        build/src/AA720.c.o(.bss);
        build/src/AB3F0.c.o(.bss);
        build/src/AB810.c.o(.bss);
        build/src/AC3B0.c.o(.bss);
        build/src/ADE20.c.o(.bss);
        build/src/ADE30.c.o(.bss);
        build/src/ADE40.c.o(.bss);
        build/src/ADEF0.c.o(.bss);
        build/src/AE950.c.o(.bss);
        build/src/AE960.c.o(.bss);
        build/src/AE970.c.o(.bss);
        build/src/AE9B0.c.o(.bss);
        build/src/AEA90.c.o(.bss);
        build/src/AEAE0.c.o(.bss);
        build/src/AEB30.c.o(.bss);
        build/src/AEC20.c.o(.bss);
        build/src/AEC80.c.o(.bss);
        build/src/AECD0.c.o(.bss);
        build/src/AEDE0.c.o(.bss);
        build/src/AEDF0.c.o(.bss);
        build/src/AF0D0.c.o(.bss);
        build/src/AF2E0.c.o(.bss);
        build/src/AFD70.c.o(.bss);
        build/src/B0360.c.o(.bss);
        build/src/B1150.c.o(.bss);
        build/src/B1170.c.o(.bss);
        build/src/B1330.c.o(.bss);
        build/src/B1350.c.o(.bss);
        build/src/B14D0.c.o(.bss);
        build/src/B1910.c.o(.bss);
        build/src/B1AF0.c.o(.bss);
        build/src/B1BC0.c.o(.bss);
        build/src/B1CE0.c.o(.bss);
        build/src/B1DB0.c.o(.bss);
        build/src/B2020.c.o(.bss);
        build/src/B2310.c.o(.bss);
        build/src/B2410.c.o(.bss);
        build/src/B2420.c.o(.bss);
        build/src/B2430.c.o(.bss);
        build/src/B2470.c.o(.bss);
        build/src/B24A0.c.o(.bss);
        build/src/B2800.c.o(.bss);
        build/src/B2870.c.o(.bss);
        build/src/B28C0.c.o(.bss);
        build/src/B2C60.c.o(.bss);
        build/src/B3000.c.o(.bss);
        build/src/B3700.c.o(.bss);
        build/src/B3AA0.c.o(.bss);
        build/src/B3B20.c.o(.bss);
        build/src/B3B70.c.o(.bss);
        build/src/B3BB0.c.o(.bss);
        build/src/B3BF0.c.o(.bss);
        build/src/B3C20.c.o(.bss);
        build/src/B3C40.c.o(.bss);
        build/src/B3CD0.c.o(.bss);
        build/src/B3D90.c.o(.bss);
        build/src/B3DC0.c.o(.bss);
        build/src/B3E00.c.o(.bss);
        build/src/B3E40.c.o(.bss);
        build/src/B3EC0.c.o(.bss);
        build/src/B3F80.c.o(.bss);
        build/src/B3FB0.c.o(.bss);
        build/src/B3FE0.c.o(.bss);
        build/src/B4070.c.o(.bss);
        build/src/B40B0.c.o(.bss);
        build/src/B41E0.c.o(.bss);
        build/src/B4340.c.o(.bss);
        build/src/B4380.c.o(.bss);
        build/src/B43C0.c.o(.bss);
        build/src/B4420.c.o(.bss);
        build/src/B4470.c.o(.bss);
        build/src/B4500.c.o(.bss);
        build/src/B45F0.c.o(.bss);
        build/src/B4680.c.o(.bss);
        build/src/B4780.c.o(.bss);
        build/src/B4810.c.o(.bss);
        build/src/B4910.c.o(.bss);
        build/src/B4B40.c.o(.bss);
        build/src/B4CB0.c.o(.bss);
        build/src/B50B0.c.o(.bss);
        build/src/B5650.c.o(.bss);
        build/src/B5A00.c.o(.bss);
        build/src/B5B90.c.o(.bss);
        build/src/B6270.c.o(.bss);
        build/src/B6930.c.o(.bss);
        build/src/B6E80.c.o(.bss);
        build/src/B6EE0.c.o(.bss);
        build/src/B6F40.c.o(.bss);
        build/src/B6FB0.c.o(.bss);
        build/src/B7010.c.o(.bss);
        build/src/B7610.c.o(.bss);
        build/src/B77A0.c.o(.bss);
        build/src/B7920.c.o(.bss);
        build/src/B7B50.c.o(.bss);
        build/src/B7EB0.c.o(.bss);
        build/src/B8490.c.o(.bss);
        build/src/B8640.c.o(.bss);
        build/src/B87C0.c.o(.bss);
        build/src/B8920.c.o(.bss);
        main_BSS_END = .;
    }
    main_ROM_END = 0xB8AC0;
    __romPos = 0xB8AC0;

    __romPos = 0xB8AC0;
    . = __romPos;
    B8AC0_ROM_START = __romPos;
    B8AC0_VRAM = ADDR(.B8AC0);
    .B8AC0 : AT(B8AC0_ROM_START) SUBALIGN(16)
    {
        B8AC0_TEXT_END = .;
        B8AC0_DATA_START = .;
        B8AC0_bin = .;
        build/assets/B8AC0.bin.o(.data);
        B8AC0_DATA_END = .;
    }
    B8AC0_ROM_END = 0x2000000;
    __romPos = 0x2000000;

    /DISCARD/ :
    {
        *(*);
    }
}
